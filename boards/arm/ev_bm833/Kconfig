## boards/arm/ev_bm833/Kconfig
```kconfig
# Copyright (c) 2022 Traxon technologies

config BOARD_ENABLE_DCDC
    bool "Enable DCDC mode"
    select SOC_DCDC_NRF52X
    default y
    depends on BOARD_EV_BM833
```

## boards/arm/ev_bm833/Kconfig.board
```kconfig
# Copyright (c) 2022 Traxon technologies

config BOARD_EV_BM833
    bool "NRF52833 DK NRF52833"
    depends on SOC_NRF52833_QIAA
```

## boards/arm/ev_bm833/Kconfig.defconfig
```kconfig
# Copyright (c) 2022 Traxon technologies

if BOARD_EV_BM833

config BOARD
    default "ev_bm833"

config BT_CTLR
    default BT

endif # BOARD_EV_BM833
```
